## boards/lpgalaxy/le_zapybara/board.yml
```yaml
board:
  name: le_zapybara
  vendor: lpgalaxy
  socs:
    - name: nrf52840
  revision:
    format: major.minor.patch
    default: 0.0.2
    exact: true
    revisions:
    - name: 0.0.2
    - name: 0.0.1
```

## boards/sporkus/sporkus_le_capybara/Kconfig.defconfig
```kconfig
# Le Chiffre (stm32) board configuration

# Copyright (c) 2020 The ZMK Contributors
# SPDX-License-Identifier: MIT

if BOARD_SPORKUS_LE_CAPYBARA

config ZMK_KEYBOARD_NAME
    default "Le Capybara"

endif # BOARD_SPORKUS_LE_CAPYBARA
```

## boards/sporkus/sporkus_le_capybara/Kconfig.sporkus_le_capybara
```kconfig
# Copyright (c) 2020 The ZMK Contributors
# SPDX-License-Identifier: Apache-2.0

config BOARD_SPORKUS_LE_CAPYBARA
	select SOC_STM32F072XB
	imply RETAINED_MEM
	imply RETENTION
	imply RETENTION_BOOT_MODE
	imply STM32_BOOTLOADER
	imply RTC
	imply BBRAM
```

## boards/sporkus/sporkus_le_capybara/board.yml
```yaml
board:
  name: sporkus_le_capybara
  vendor: sporkus
  socs:
    - name: stm32f072xb
```
