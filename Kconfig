## Kconfig
```kconfig
rsource "drivers/Kconfig"


config SLEEP_AWAKE_TRIGGER
    bool "Awake trigger support for ZMK sleep wake-up"
    default y
    depends on ZMK_SLEEP
```

## boards/arm/lpgalaxy_le_zapybara/Kconfig.board
```kconfig
# Le Zapybara board configuration

# Copyright (c) 2020 The ZMK Contributors
# SPDX-License-Identifier: MIT

config BOARD_LPGALAXY_LE_ZAPYBARA
    bool "Le Zapybara"
    select ZMK_KSCAN_EC_MATRIX_FAKE_OPEN_DRAIN
    imply ZMK_KSCAN_EC_MATRIX_DYNAMIC_POLL_RATE
    imply SPI
    depends on SOC_NRF52840_QIAA
```

## boards/arm/lpgalaxy_le_zapybara/Kconfig.defconfig
```kconfig
# Le Zapybara board configuration

# Copyright (c) 2020 The ZMK Contributors
# SPDX-License-Identifier: MIT

if BOARD_LPGALAXY_LE_ZAPYBARA

config BOARD
    default "lpgalaxy_le_zapybara"

config ZMK_KEYBOARD_NAME
    default "Le Zapybara"

config ZMK_SLEEP
	select ZMK_ADXL362_AWAKE_TRIGGER_SLEEP
	depends on ZMK_ADXL362_AWAKE_TRIGGER

if ZMK_BATTERY_REPORTING

choice ZMK_BATTERY_REPORTING_FETCH_MODE
	default ZMK_BATTERY_REPORTING_FETCH_MODE_LITHIUM_VOLTAGE
endchoice

endif

if USB

config USB_NRFX
	default y

config USB_DEVICE_STACK
	default y

endif # USB

config BT_CTLR
	default BT

endif # BOARD_LPGALAXY_LE_ZAPYBARA
```

## boards/arm/sporkus_le_capybara/Kconfig.board
```kconfig
# Le Chiffre (stm32) board configuration

# Copyright (c) 2020 The ZMK Contributors
# SPDX-License-Identifier: MIT

config BOARD_SPORKUS_LE_CAPYBARA
    bool "Le Capybara"
    depends on SOC_STM32F072XB
```

## boards/arm/sporkus_le_capybara/Kconfig.defconfig
```kconfig
# Le Chiffre (stm32) board configuration

# Copyright (c) 2020 The ZMK Contributors
# SPDX-License-Identifier: MIT

if BOARD_SPORKUS_LE_CAPYBARA

config BOARD
    default "sporkus_le_capybara"

config ZMK_KEYBOARD_NAME
    default "Le Capybara"

endif # BOARD_SPORKUS_LE_CAPYBARA
```

## boards/arm/sporkus_le_capybara/sporkus_le_capybara_defconfig
```kconfig
# SPDX-License-Identifier: MIT

CONFIG_BOARD_SPORKUS_LE_CAPYBARA=y
CONFIG_SOC_SERIES_STM32F0X=y
CONFIG_SOC_STM32F072XB=y
# 48MHz system clock
CONFIG_SYS_CLOCK_HW_CYCLES_PER_SEC=48000000

# Free some RAM
CONFIG_SRAM_VECTOR_TABLE=n

# enable PINMUX
CONFIG_PINCTRL=y

# enable GPIO
CONFIG_GPIO=y

# Enable i2c
CONFIG_ADC=y

# ZMK Settings
CONFIG_ZMK_USB=y

# Settings subsystem
CONFIG_SETTINGS=y
CONFIG_FLASH=y
CONFIG_FLASH_MAP=y
CONFIG_NVS=y
CONFIG_SETTINGS_NVS=y

CONFIG_USB_SELF_POWERED=n

# clock configuration
CONFIG_CLOCK_CONTROL=y

# RAM Conservation
CONFIG_ISR_STACK_SIZE=768
CONFIG_SYSTEM_WORKQUEUE_STACK_SIZE=768
CONFIG_USB_CDC_ACM_RINGBUF_SIZE=768

# Behavior related RAM conservation
CONFIG_ZMK_BEHAVIOR_STICKY_KEY_MAX_HELD=4
CONFIG_ZMK_COMBO_MAX_PRESSED_COMBOS=2
CONFIG_ZMK_BEHAVIORS_QUEUE_SIZE=8

# Tweaks when using shell/calibrator
CONFIG_SHELL_STACK_SIZE=768
CONFIG_FLASH_SHELL=n
CONFIG_SHELL_MINIMAL=y
CONFIG_ADC_SHELL=n
```

## drivers/gpio/Kconfig
```kconfig
if GPIO

config ZMK_GPIO_MUX
    bool "Multiplexer (mux) GPIO Driver"
    depends on DT_HAS_ZMK_GPIO_MUX_ENABLED
    default y


endif
```

## drivers/kscan/Kconfig
```kconfig
if KSCAN

config ZMK_KSCAN_EC_MATRIX
    bool "EC Matrix KScan Driver"
    depends on DT_HAS_ZMK_KSCAN_EC_MATRIX_ENABLED
    default y

if ZMK_KSCAN_EC_MATRIX

config ZMK_KSCAN_EC_MATRIX_THREAD_PRIORITY
	int "Thread priority"
	default -1
	help
	  Priority of thread used by the driver to handle interrupts.

config ZMK_KSCAN_EC_MATRIX_THREAD_STACK_SIZE
	int "Thread stack size"
	default 1024
	help
	  Stack size of thread used by the driver to handle interrupts.

endif

endif
```

## drivers/misc/Kconfig
```kconfig
config ZMK_ADXL362_AWAKE_TRIGGER
    bool "ADXL362 Awake Trigger"
    default y
    depends on SPI && DT_HAS_ZMK_ADXL362_AWAKE_TRIGGER_ENABLED
    select PM_DEVICE

if ZMK_ADXL362_AWAKE_TRIGGER

config ZMK_ADXL362_AWAKE_TRIGGER_SLEEP
    bool "Sleep Mode"

config ZMK_ADXL362_AWAKE_TRIGGER_LED_DEBUG
    bool "Drive led0 alias for awake/sleep state for debugging purposes"

endif
```

## dts/bindings/kscan/zmk,kscan-ec-matrix.yaml
```yaml
# Copyright (c) 2020, The ZMK Contributors
# SPDX-License-Identifier: MIT

description: GPIO keyboard demux controller

compatible: "zmk,kscan-ec-matrix"

include: kscan.yaml

properties:
  active-polling-interval-ms:
    type: int
    default: 1
  idle-polling-interval-ms:
    type: int
    default: 5
  sleep-polling-interval-ms:
    type: int
    default: 500
  matrix-warm-up-ms:
    type: int
  matrix-relax-us:
    type: int
  adc-read-settle-us:
    type: int
  power-gpios:
    type: phandle-array
  input-gpios:
    type: phandle-array
    required: true
  strobe-gpios:
    type: phandle-array
    required: true
  strobe-input-masks:
    type: array
    description: Array of masked inputs for each strobe line. Those set bits are indexes of inputs to skip for each strobe line.
  drain-gpios:
    type: phandle-array
  io-channels:
    required: true
```

## dts/bindings/misc/zmk,adxl362-awake-trigger.yaml
```yaml
# Copyright (c) 2018, NXP
# SPDX-License-Identifier: Apache-2.0

description: ADXL362 3-axis SPI accelerometer simple waker

compatible: "zmk,adxl362-awake-trigger"

include: [spi-device.yaml]
 
properties:
  linked-devices:
    type: phandles
    description: |
      Devices that should be suspended/resumed based on awake status
  int1-gpios:
    type: phandle-array
    description: |
      The INT1 signal defaults to active high as produced by the
      sensor.  The property value should ensure the flags properly
      describe the signal that is presented to the driver.

  int2-gpios:
    type: phandle-array
    description: |
      The INT2 signal defaults to active high as produced by the
      sensor.  The property value should ensure the flags properly
      describe the signal that is presented to the driver.
```
