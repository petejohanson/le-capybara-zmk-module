
/ {
	chosen {
		zephyr,shell-uart = &snippet_enable_ec_calibrator_uart;
	};
};


&zephyr_udc0 {
	snippet_enable_ec_calibrator_uart: snippet_enable_ec_calibrator_uart {
		compatible = "zephyr,cdc-acm-uart";
	};
};
